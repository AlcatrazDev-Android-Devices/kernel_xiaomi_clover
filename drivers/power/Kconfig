## drivers/power/Kconfig
```kconfig
config HQ_ZQL5018_NTCLOSS
	bool "HQ_ZQL5018_NTCLOSS"
	default n

source "drivers/power/avs/Kconfig"
source "drivers/power/reset/Kconfig"
source "drivers/power/supply/Kconfig"
```
